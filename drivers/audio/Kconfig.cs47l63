## drivers/audio/Kconfig.cs47l63
```kconfig
# SPDX-FileCopyrightText: Copyright The Zephyr Project Contributors
# SPDX-License-Identifier: Apache-2.0

config AUDIO_CS47L63
	bool "Cirrus Logic CS47L63 Audio DSP driver"
	default y
	depends on DT_HAS_CIRRUS_CS47L63_ENABLED
	depends on SPI
	depends on I2S
	depends on GPIO
	help
	  Enable driver support for the Cirrus Logic CS47L63 Low-Power Audio
	  DSP.  The CS47L63 is a member of the Madera codec family.  It is
	  used on the nRF5340 Audio Development Kit as the hardware audio
	  codec.

	  The driver implements the Zephyr audio_codec API.  Control
	  (register access) is performed over SPI, while audio data is
	  streamed via an I2S peripheral on the host SoC.

if AUDIO_CS47L63

config AUDIO_CS47L63_TX_THREAD_PRIORITY
	int "CS47L63 TX streaming thread priority"
	default 5
	help
	  Priority of the thread that feeds I2S DMA buffers.  A higher
	  numeric value means lower priority.  This thread must run often
	  enough to keep up with the audio data rate.

endif # AUDIO_CS47L63
```

## samples/bluetooth/bap_broadcast_source/Kconfig
```kconfig
# Copyright (c) 2023 Demant A/S
# Copyright (c) 2023 Nordic Semiconductor ASA
# SPDX-License-Identifier: Apache-2.0

mainmenu "Bluetooth: Broadcast Audio Source"

choice BAP_LC3_PRESET
	prompt "The BAP LC3 Preset to be used"
	default BAP_BROADCAST_16_2_1

config BAP_BROADCAST_16_2_1
	bool "BAP_LC3_BROADCAST_PRESET_16_2_1 preset"
	help
	  Using the BAP_LC3_BROADCAST_PRESET_16_2_1 preset.

config BAP_BROADCAST_24_2_1
	bool "BAP_LC3_BROADCAST_PRESET_24_2_1 preset"
	help
	  Using the BAP_LC3_BROADCAST_PRESET_24_2_1 preset.

config BAP_BROADCAST_48_2_1
	bool "BAP_LC3_BROADCAST_PRESET_48_2_1 preset"
	help
	  Using the BAP_LC3_BROADCAST_PRESET_48_2_1 preset.

endchoice

config ENABLE_LC3
	bool "Enable the LC3 codec"
	# By default let's enable it in the platforms we know are capable of supporting it
	default y
	depends on CPU_HAS_FPU && \
		(ARCH_POSIX || \
		 SOC_COMPATIBLE_NRF52X || \
		 SOC_COMPATIBLE_NRF5340_CPUAPP || \
		 SOC_COMPATIBLE_NRF54LX || \
		 SOC_MIMXRT1062)
	select LIBLC3
	select FPU

config ISO_PACKING_INTERLEAVED
	bool "Use interleaved packing"
	help
	  Use interleaved packing between BIS ISO stream subevents.

config USE_USB_AUDIO_INPUT
	bool "Use USB Audio as input"
	# By default, use the USB Audio path is disabled.
	default n
	depends on ENABLE_LC3
	select USB_DEVICE_STACK_NEXT
	select USBD_AUDIO2_CLASS
	select RING_BUFFER

config USE_PIPEWIRE_AUDIO_INPUT
	bool "Use PipeWire audio as input"
	default n
	depends on ENABLE_LC3
	depends on ARCH_POSIX
	depends on EXTERNAL_LIBC
	depends on BOARD_NATIVE_SIM_NATIVE_64
	help
	  Enables PipeWire audio capture as the audio source when running on
	  native_sim/native/64. Audio is captured from a PipeWire source at
	  48 kHz stereo and decimated to the selected broadcast sample rate.
	  This option co-exists with the sine-wave generator; when enabled it
	  replaces the sine wave rather than the USB path.

if USE_PIPEWIRE_AUDIO_INPUT

config BROADCAST_SOURCE_PIPEWIRE_SOURCE
	string "Default PipeWire capture source target"
	default ""
	help
	  Optional default PipeWire source node to capture from. Leave empty
	  to let PipeWire choose the default source. May be overridden at
	  runtime with --bt-broadcast-source-pcm-source=<node>.

config BROADCAST_SOURCE_PIPEWIRE_LATENCY
	string "Default PipeWire capture latency"
	default "480/48000"
	help
	  Default PipeWire node latency for the capture stream. The format is
	  PipeWire's usual quantum/rate string, for example 480/48000 for
	  10 ms. May be overridden at runtime with
	  --bt-broadcast-source-pcm-latency=<latency>.

endif # USE_PIPEWIRE_AUDIO_INPUT

config BROADCAST_CODE
	string "The broadcast code (if any) to use for encrypted broadcast"
	default ""
	help
	   Setting a non-empty string for this option will encrypt the broadcast using this
	   string as the broadcast code. The length of the string shall be between 1 and 16 octets.

config STATIC_BROADCAST_ID
	bool "Use static broadcast ID"
	default y
	help
	   Enabling this option will make the application use static broadcast ID, as opposed to a
	   randomly generated one.

config BROADCAST_ID
	hex "The static broadcast ID to use"
	range 0x000000 0xFFFFFF
	depends on STATIC_BROADCAST_ID
	default 0x123456
	help
	   This is the 3-octet broadcast ID advertised if static broadcast IDs are enabled.

config BROADCAST_NAME
	string "Bluetooth broadcast name"
	default BT_DEVICE_NAME
	help
	   Bluetooth broadcast name. Can be used for scanning device that displays information on the
	   available broadcast sources. Name length range is 4 to 32.

# Source common USB sample options used to initialize new experimental USB device stack.
# The scope of these options is limited to USB samples in project tree,
# you cannot use them in your own application.
source "samples/subsys/usb/common/Kconfig.sample_usbd"

source "Kconfig.zephyr"
```
